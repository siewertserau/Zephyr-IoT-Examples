## prj.conf
```kconfig
CONFIG_STDOUT_CONSOLE=y
CONFIG_FLOAT=y
CONFIG_FP_SHARING=y
CONFIG_SSE=y
CONFIG_SSE_FP_MATH=y
CONFIG_NUM_TASK_PRIORITIES=100
```

## src/main.c
```c
#include <zephyr.h>
#include <microkernel.h>

#if defined(CONFIG_STDOUT_CONSOLE)
#include <stdio.h>
#include <stdlib.h>
#define PRINT           printf
#else
#include <misc/printk.h>
#define PRINT           printk
#endif

// https://www.zephyrproject.org/doc/kernel/common/common_float.html

#include "image.h"

UINT8 convGrayVal[IMG_HEIGHT*IMG_WIDTH];

#define K 4.0
#define FRAME_RATE (60)
typedef double FLOAT;


void transform(void);

void main(void)
{
    PRINT("START: Transforming an 80x60 image buffer %d times\n", FRAME_RATE);
    task_start(TRANS_TASK);
    PRINT("DONE: Transforming an 80x60 image buffer %d times\n", FRAME_RATE);
}

void transform(void)
{
    int row, col, frameIdx=0;
    int64_t time_stamp, ticks_spent;
    FLOAT temp=0.0;
    FLOAT PSF[9] = {(-K/8.0), (-K/8.0), (-K/8.0), (-K/8.0), (K+1.0), (-K/8.0), (-K/8.0), (-K/8.0), (-K/8.0)};

    PRINT("TRANSFORM START\n");

    for(frameIdx=0; frameIdx < FRAME_RATE; frameIdx++)
    {
        time_stamp = sys_tick_get();
        PRINT("Frame %d @ %lu\n", frameIdx, time_stamp);

        // Skip first and last row, no neighbors to convolve with
        for(row=1; row<((IMG_HEIGHT)-1); row++)
        {

            // Skip first and last column, no neighbors to convolve with
            for(col=1; col<((IMG_WIDTH)-1); col++)
            {
                temp=0.0;
                temp += ((PSF[0]) * ((FLOAT)GrayVal[((row-1)*IMG_WIDTH)+col-1]));
                temp += (PSF[1] * (FLOAT)GrayVal[((row-1)*IMG_WIDTH)+col]);
                temp += (PSF[2] * (FLOAT)GrayVal[((row-1)*IMG_WIDTH)+col+1]);
                temp += (PSF[3] * (FLOAT)GrayVal[((row)*IMG_WIDTH)+col-1]);
                temp += (PSF[4] * (FLOAT)GrayVal[((row)*IMG_WIDTH)+col]);
                temp += (PSF[5] * (FLOAT)GrayVal[((row)*IMG_WIDTH)+col+1]);
                temp += (PSF[6] * (FLOAT)GrayVal[((row+1)*IMG_WIDTH)+col-1]);
                temp += (PSF[7] * (FLOAT)GrayVal[((row+1)*IMG_WIDTH)+col]);
                temp += (PSF[8] * (FLOAT)GrayVal[((row+1)*IMG_WIDTH)+col+1]);

                if(temp < 0.0) temp=0.0;
                if(temp > 255.0) temp=255.0;

                convGrayVal[(row*IMG_WIDTH)+col]=(UINT8)temp;
            }
        }
        ticks_spent = sys_tick_delta(&time_stamp);
        PRINT("Frame %d TRANSFORMED in %lu microsec\n", frameIdx, (ticks_spent*sys_clock_us_per_tick));
    }

    PRINT("TRANSFORM END\n");

    PRINT("HEX IMAGE:\n");
    for(row=0; row<IMG_HEIGHT; row++)
    {
        for(col=0; col<IMG_WIDTH; col++)
        {
           PRINT("%02X ", convGrayVal[(row*IMG_WIDTH)+col]);
        }
        PRINT("\n");
    }
}
```

## src/image.h
```c
#define IMG_HEIGHT (30)
#define IMG_WIDTH (40)

typedef unsigned char UINT8;

// Test image data - sunset PGM thumbnail.
//
UINT8 GrayVal[IMG_HEIGHT*IMG_WIDTH] =
{
0x43,0x46,0x48,0x4d,0x50,0x53,0x56,0x58,0x5a,0x5c,0x5e,0x60,0x61,0x63,0x65,0x66,0x67,0x68,0x68,0x67,0x67,0x66,0x65,0x63,0x62,0x60,0x5e,0x5c,0x5a,0x58,0x55,0x53,0x51,0x4e,0x4c,0x49,0x46,0x41,0x3e,0x3b,
0x4b,0x4d,0x50,0x54,0x57,0x59,0x5c,0x5f,0x61,0x64,0x64,0x66,0x68,0x6a,0x6c,0x6d,0x6e,0x70,0x6f,0x6e,0x6e,0x6d,0x6c,0x6a,0x69,0x67,0x65,0x63,0x61,0x5f,0x5c,0x59,0x57,0x55,0x53,0x51,0x4f,0x49,0x45,0x40,
0x56,0x54,0x57,0x5c,0x5e,0x5f,0x61,0x64,0x66,0x6b,0x6c,0x6e,0x70,0x71,0x73,0x74,0x75,0x77,0x76,0x76,0x74,0x74,0x73,0x71,0x6f,0x6e,0x6c,0x6a,0x67,0x64,0x62,0x61,0x61,0x5e,0x5a,0x57,0x55,0x51,0x4c,0x47,
0x66,0x67,0x64,0x65,0x67,0x69,0x6a,0x6c,0x6e,0x71,0x75,0x78,0x79,0x79,0x7b,0x7c,0x7d,0x7e,0x7e,0x7f,0x7d,0x7c,0x7b,0x79,0x77,0x75,0x73,0x71,0x6e,0x6c,0x6d,0x6d,0x6a,0x67,0x62,0x5d,0x5a,0x55,0x51,0x4d,
0x6a,0x70,0x73,0x75,0x75,0x74,0x77,0x78,0x78,0x79,0x7a,0x7c,0x80,0x81,0x84,0x84,0x86,0x86,0x85,0x85,0x84,0x83,0x82,0x80,0x7e,0x7c,0x7a,0x78,0x75,0x75,0x76,0x73,0x73,0x70,0x68,0x62,0x5e,0x5a,0x57,0x52,
0x73,0x77,0x77,0x78,0x7e,0x81,0x82,0x84,0x87,0x84,0x85,0x87,0x88,0x8a,0x8f,0x90,0x91,0x92,0x93,0x91,0x8e,0x8b,0x8a,0x88,0x85,0x83,0x80,0x7e,0x7c,0x7c,0x7a,0x78,0x78,0x73,0x6b,0x67,0x63,0x5e,0x5b,0x57,
0x79,0x7c,0x7e,0x7f,0x7e,0x7c,0x7f,0x82,0x85,0x88,0x8a,0x8c,0x91,0x95,0x98,0x99,0x9b,0x9e,0xa0,0xa2,0xa2,0x9c,0x9c,0x95,0x92,0x8f,0x8d,0x88,0x84,0x82,0x7f,0x7c,0x79,0x75,0x71,0x6d,0x68,0x64,0x61,0x5d,
0x73,0x76,0x7a,0x80,0x85,0x88,0x89,0x8a,0x8c,0x8e,0x90,0x92,0x95,0x99,0x9c,0x9f,0xa1,0xa3,0xa2,0xa1,0xa2,0xa0,0x9d,0x9b,0x98,0x95,0x92,0x8f,0x8b,0x88,0x83,0x7f,0x7c,0x79,0x75,0x71,0x6e,0x69,0x66,0x63,
0x75,0x77,0x7b,0x80,0x84,0x8a,0x8f,0x93,0x96,0x96,0x98,0x9b,0x9e,0xa2,0xa5,0xaa,0xab,0xac,0xb0,0xab,0xa7,0xa4,0xa1,0x9e,0x9b,0x98,0x95,0x91,0x8e,0x8b,0x86,0x82,0x7f,0x7c,0x78,0x75,0x72,0x6d,0x6b,0x69,
0x79,0x7d,0x81,0x86,0x8a,0x8d,0x93,0x98,0x9c,0xa1,0xa5,0xa7,0xac,0xaf,0xb2,0xb5,0xb8,0xba,0xba,0xb5,0xb1,0xad,0xaa,0xa6,0xa2,0xa1,0x9c,0x99,0x95,0x91,0x8e,0x8a,0x86,0x82,0x7f,0x7a,0x77,0x73,0x70,0x6c,
0x7c,0x7f,0x83,0x89,0x8d,0x91,0x96,0x9c,0xa1,0xa5,0xaa,0xaf,0xb5,0xbb,0xc0,0xc1,0xc4,0xc8,0xc7,0xc2,0xbc,0xb6,0xb2,0xae,0xa8,0xa4,0xa0,0x9c,0x99,0x95,0x91,0x8d,0x8a,0x87,0x83,0x7f,0x7b,0x76,0x73,0x70,
0x7f,0x82,0x86,0x8b,0x8f,0x93,0x98,0x9c,0xa1,0xa6,0xaa,0xaf,0xb8,0xbf,0xc6,0xce,0xd1,0xd3,0xd2,0xce,0xc7,0xc1,0xbc,0xb8,0xb5,0xab,0xa5,0xa0,0x9c,0x99,0x95,0x91,0x8d,0x89,0x85,0x81,0x7e,0x79,0x75,0x71,
0x83,0x86,0x8b,0x8f,0x93,0x97,0x9c,0x9f,0xa4,0xa8,0xad,0xb2,0xb9,0xc3,0xcd,0xd3,0xd9,0xdd,0xdb,0xd5,0xd1,0xc9,0xc2,0xc2,0xbe,0xb2,0xa8,0xa4,0xa3,0x9c,0x96,0x92,0x8d,0x89,0x85,0x81,0x7d,0x78,0x74,0x71,
0x80,0x83,0x88,0x8d,0x90,0x95,0x99,0x9c,0xa0,0xa5,0xaa,0xb0,0xb9,0xc4,0xcd,0xd8,0xe6,0xee,0xe8,0xdc,0xd2,0xc8,0xbe,0xb7,0xb1,0xac,0xa6,0xa0,0x9b,0x97,0x93,0x8e,0x8a,0x85,0x81,0x7d,0x79,0x74,0x70,0x6c,
0x76,0x79,0x7d,0x82,0x86,0x8a,0x8f,0x93,0x97,0x9d,0xa2,0xa8,0xb3,0xbe,0xc8,0xd7,0xea,0xf9,0xf2,0xe0,0xd0,0xc3,0xb9,0xb0,0xa7,0xa0,0x9b,0x95,0x91,0x8d,0x89,0x84,0x80,0x7d,0x78,0x73,0x6f,0x6a,0x66,0x62,
0x64,0x67,0x6c,0x71,0x75,0x79,0x7e,0x82,0x87,0x8d,0x93,0x9a,0xa5,0xb0,0xbc,0xcd,0xdf,0xea,0xe7,0xd8,0xc5,0xb6,0xaa,0x9f,0x95,0x8d,0x88,0x82,0x7d,0x78,0x74,0x6e,0x6a,0x65,0x5f,0x5b,0x56,0x51,0x4d,0x49,
0x4f,0x52,0x56,0x5a,0x5e,0x62,0x67,0x6b,0x6f,0x75,0x7a,0x81,0x8b,0x97,0xa5,0xb6,0xc4,0xce,0xcc,0xbf,0xb1,0x9f,0x90,0x86,0x7d,0x75,0x6f,0x69,0x64,0x5f,0x5a,0x55,0x51,0x4c,0x47,0x42,0x3b,0x36,0x39,0x36,
0x42,0x45,0x48,0x4d,0x50,0x54,0x59,0x5d,0x61,0x65,0x6a,0x70,0x79,0x83,0x8f,0x9d,0xaa,0xb4,0xb0,0xa4,0x98,0x8b,0x80,0x77,0x6f,0x67,0x62,0x5d,0x58,0x54,0x4f,0x4a,0x46,0x41,0x25,0x1a,0x15,0x14,0x1e,0x26,
0x38,0x3b,0x3e,0x43,0x46,0x4a,0x50,0x54,0x58,0x5d,0x62,0x67,0x6e,0x76,0x7e,0x87,0x91,0xa3,0x9c,0x8d,0x85,0x7d,0x76,0x6e,0x67,0x60,0x5b,0x56,0x52,0x4e,0x43,0x38,0x28,0x16,0x0d,0x0c,0x0b,0x0a,0x08,0x08,
0x33,0x35,0x39,0x3e,0x42,0x45,0x4c,0x50,0x53,0x56,0x5b,0x61,0x66,0x6c,0x73,0x78,0x82,0x94,0x8f,0x7d,0x77,0x70,0x6b,0x65,0x5f,0x5b,0x56,0x52,0x49,0x34,0x20,0x11,0x0d,0x0c,0x0c,0x0a,0x09,0x09,0x08,0x08,
0x30,0x33,0x35,0x3a,0x3d,0x41,0x46,0x49,0x4d,0x51,0x54,0x58,0x5e,0x65,0x6c,0x6d,0x77,0x8c,0x86,0x71,0x6b,0x65,0x61,0x5d,0x58,0x54,0x4d,0x3c,0x24,0x14,0x0e,0x0d,0x0b,0x0b,0x0a,0x09,0x08,0x07,0x07,0x06,
0x2e,0x30,0x32,0x35,0x37,0x3a,0x3d,0x41,0x44,0x48,0x4d,0x50,0x54,0x5a,0x5e,0x61,0x6a,0x7a,0x73,0x64,0x5e,0x5a,0x58,0x54,0x4f,0x3e,0x22,0x16,0x12,0x0e,0x0c,0x0b,0x0a,0x09,0x09,0x08,0x07,0x07,0x06,0x06,
0x2b,0x2d,0x2f,0x32,0x35,0x38,0x3c,0x3f,0x42,0x47,0x48,0x4b,0x4f,0x54,0x57,0x5a,0x64,0x75,0x71,0x60,0x58,0x52,0x4f,0x49,0x32,0x1a,0x14,0x12,0x0e,0x0c,0x0b,0x0b,0x09,0x09,0x08,0x07,0x07,0x07,0x06,0x06,
0x29,0x2b,0x2d,0x30,0x32,0x34,0x36,0x38,0x38,0x37,0x2a,0x30,0x40,0x44,0x43,0x43,0x45,0x5d,0x6b,0x5e,0x54,0x4f,0x43,0x29,0x17,0x12,0x10,0x0f,0x0c,0x0b,0x0a,0x09,0x08,0x08,0x07,0x07,0x06,0x06,0x06,0x05,
0x1f,0x1f,0x24,0x28,0x2a,0x23,0x1c,0x1b,0x18,0x19,0x19,0x1b,0x1e,0x20,0x22,0x24,0x25,0x27,0x2b,0x34,0x3b,0x36,0x1e,0x14,0x11,0x10,0x0e,0x0c,0x0b,0x09,0x09,0x08,0x08,0x07,0x07,0x06,0x06,0x06,0x05,0x06,
0x10,0x0f,0x13,0x15,0x13,0x11,0x12,0x12,0x13,0x13,0x15,0x17,0x19,0x1a,0x1c,0x1d,0x1e,0x1e,0x1e,0x1d,0x1d,0x18,0x13,0x11,0x0f,0x0d,0x0b,0x0b,0x0a,0x09,0x08,0x07,0x07,0x07,0x06,0x06,0x06,0x05,0x05,0x05,
0x0c,0x0c,0x0d,0x0e,0x0e,0x0f,0x0f,0x0f,0x10,0x11,0x12,0x13,0x15,0x16,0x18,0x19,0x19,0x19,0x17,0x16,0x14,0x12,0x10,0x0e,0x0d,0x0c,0x0a,0x09,0x09,0x08,0x07,0x07,0x07,0x06,0x06,0x05,0x05,0x05,0x05,0x05,
0x09,0x09,0x0b,0x0b,0x0b,0x0c,0x0d,0x0d,0x0e,0x0f,0x0f,0x0f,0x10,0x12,0x12,0x13,0x14,0x15,0x12,0x11,0x0f,0x0f,0x0d,0x0b,0x0b,0x0a,0x09,0x09,0x08,0x07,0x07,0x07,0x06,0x06,0x06,0x05,0x05,0x05,0x05,0x05,
0x08,0x08,0x09,0x0a,0x0a,0x0a,0x0b,0x0c,0x0c,0x0d,0x0d,0x0d,0x0d,0x0f,0x0f,0x10,0x10,0x0f,0x0f,0x0e,0x0d,0x0c,0x0c,0x0b,0x0a,0x09,0x08,0x08,0x08,0x07,0x07,0x06,0x06,0x06,0x05,0x05,0x05,0x05,0x05,0x05,
0x07,0x07,0x08,0x08,0x09,0x09,0x0a,0x0a,0x0a,0x0b,0x0b,0x0c,0x0b,0x0c,0x0d,0x0d,0x0d,0x0d,0x0d,0x0c,0x0b,0x0a,0x0a,0x09,0x09,0x08,0x07,0x07,0x07,0x06,0x06,0x05,0x05,0x05,0x05,0x05,0x05,0x05,0x05,0x05,
};
```
